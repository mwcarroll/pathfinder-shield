## boards/shields/pathfinder/Kconfig.defconfig
```kconfig
if SHIELD_PATHFINDER_LEFT

config ZMK_KEYBOARD_NAME
    default "Pathfinder"

config ZMK_SPLIT_ROLE_CENTRAL
    default y

endif

if SHIELD_PATHFINDER_LEFT || SHIELD_PATHFINDER_RIGHT

config ZMK_SPLIT
    default y

endif
```

## boards/shields/pathfinder/Kconfig.shield
```kconfig
config SHIELD_PATHFINDER_LEFT
    def_bool $(shields_list_contains,pathfinder_left)

config SHIELD_PATHFINDER_RIGHT
    def_bool $(shields_list_contains,pathfinder_right)
```
